## drivers/sensor/shock_sensor/Kconfig
```kconfig
config SENSOR_SHOCK
	bool "TIM-triggered ADC based analog shock sensor driver"
	default y
	depends on MULTITHREADING && SOC_SERIES_STM32H5X && DT_HAS_ZEPHYR_SHOCK_SENSOR_ENABLED
	select ADC
	select DMA
	select SENSOR
	help
	  Analog shock sensor using an STM32H5 timer-triggered ADC and circular DMA.

if SENSOR_SHOCK

module = SENSOR_SHOCK
module-str = sensor_shock
source "subsys/logging/Kconfig.template.log_config"

config SENSOR_SHOCK_THREAD_STACK_SIZE
	int "Stack size for the shock sensor processing thread"
	default 3072
	help
	  Stack used for DMA block copying, raw min/max processing and classification.

config SENSOR_SHOCK_THREAD_PRIORITY
	int "Priority for the shock sensor processing thread"
	default 2
	help
	  Priority of the private shock sensor work queue. Lower numeric values have
	  higher priority in Zephyr. Priority 2 gives the DMA consumer enough CPU time
	  to drain the queue during modem/CAN/logging activity without making it a
	  cooperative thread.

config SENSOR_SHOCK_DMA_STATS
	bool "Periodic DMA diagnostic statistics"
	default n
	help
	  Enable periodic and stream-stop DMA counter reports. The counters remain
	  present in the driver even when this logging is disabled.

if SENSOR_SHOCK_DMA_STATS

config SENSOR_SHOCK_STATS_INTERVAL_SEC
	int "DMA diagnostic statistics interval"
	default 5
	range 1 3600
	help
	  Period in seconds between cumulative DMA diagnostic reports while the
	  stream is running. Reports half/full callbacks, queued and processed chunks,
	  dropped chunks, unexpected callback statuses and half-order errors.

endif # SENSOR_SHOCK_DMA_STATS

endif
```

## dts/bindings/sensor/zephyr,shock-sensor.yaml
```yaml
# SPDX-License-Identifier: Apache-2.0

description: |
  STM32H5 analog shock sensor sampled by a hardware timer-triggered ADC and
  circular DMA. Each completed DMA half-buffer is evaluated using the raw
  minimum and maximum deviation from a centre calibrated when arming.

compatible: "zephyr,shock-sensor"

include: base.yaml

properties:
  io-channels:
    required: true
    description: ADC input used by the analog shock sensor.

  power-gpios:
    type: phandle-array
    description: Optional sensor power control GPIO.

  sampling-timer:
    type: phandle
    required: true
    description: STM32 timer whose TRGO update event triggers ADC conversion.

  dmas:
    required: true
    description: Circular DMA channel used to transfer ADC samples.

  dma-names:
    required: true
    const: [rx]

  sampling-period-ms:
    type: int
    default: 100
    deprecated: true
    description: |
      Legacy property retained for board compatibility. The DMA backend does
      not pause acquisition between blocks.

  sampling-frequency-hz:
    type: int
    default: 10000
    description: Hardware ADC trigger frequency in samples per second.

  dma-buffer-samples:
    type: int
    default: 256
    description: |
      Total circular DMA buffer size in ADC samples. Half and full DMA
      callbacks feed the event-processing work queue.

  baseline-update-period-ms:
    type: int
    default: 116
    deprecated: true
    description: |
      Legacy property retained for board compatibility. The baseline is fixed
      while armed and is no longer adapted periodically.

  startup-calibration-blocks:
    type: int
    default: 8
    description: |
      Number of DMA half-buffers used to calculate the ADC centre on each
      DISARMED to ARMED transition. The driver takes the median of their mean
      values and suppresses event detection until calibration completes. Valid
      range is 3 through 16.

  startup-blanking-ms:
    type: int
    default: 200
    description: |
      Time after each DMA stream start during which shock events are ignored.
      A new armed cycle also performs baseline calibration. Alarm re-arm, PM
      resume and DMA recovery retain the existing centre and apply only this
      settling delay.

  baseline-max-deviation:
    type: int
    default: 128
    description: |
      Maximum accepted absolute difference, in raw ADC counts, between the
      measured arming baseline and the expected 12-bit midpoint 2048. If the
      measured centre is farther away, it is treated as unreliable and 2048 is
      used for the complete armed cycle.

  event-quiet-ms:
    type: int
    default: 8
    description: |
      Time the block amplitude must stay below the minimum shake level before
      the active shock event is closed and classified by its captured peak.

  event-max-ms:
    type: int
    default: 120
    description: |
      Maximum duration of one shock event window. If the signal does not fall
      quiet, the event is closed and classified when this limit is reached.

  event-lockout-ms:
    type: int
    default: 20
    description: |
      Dead time after a confirmed event. Weak sub-threshold vibration does not
      start this event-output lockout.
```
